## configs/lucky7_defconfig
```kconfig
CONFIG_SIMPLE_FB=y
CONFIG_POSITION_INDEPENDENT=y
CONFIG_LINUX_KRNL_HEADER_IMG=y
CONFIG_EXYNOS_5515=y
CONFIG_SAMSUNG_LUCKY7=y
CONFIG_TEXT_BASE=0xc0000000
CONFIG_RAMDISK_ENTRY=0x84000000
CONFIG_PAYLOAD_ENTRY=0x80000000
```

## configs/moon_defconfig
```kconfig
CONFIG_COMPRESS_GZIP=y
CONFIG_EARLYCON=y
CONFIG_MT6768=y
CONFIG_XIAOMI_MOON=y
CONFIG_TEXT_BASE=0x40080000
CONFIG_RAMDISK_ENTRY=0x47c80000
CONFIG_PAYLOAD_ENTRY=0x60000000
```

## configs/n61ap_defconfig
```kconfig
CONFIG_APPLE_N61AP=y
CONFIG_PAYLOAD_ENTRY=0x830000000
CONFIG_RAMDISK_ENTRY=0x835000000
CONFIG_FRAMEBUFFER_BASE=0x83e900000
CONFIG_FRAMEBUFFER_WIDTH=752
CONFIG_FRAMEBUFFER_HEIGHT=1334
CONFIG_FRAMEBUFFER_STRIDE=4
```

## configs/nezha_defconfig
```kconfig
CONFIG_POSITION_INDEPENDENT=y
CONFIG_LINUX_KRNL_HEADER_IMG=y
CONFIG_SM8850=y
CONFIG_XIAOMI_NEZHA=y
CONFIG_TEXT_BASE=0xa6980000
CONFIG_PAYLOAD_ENTRY=0xc4800000
CONFIG_RAMDISK_ENTRY=0xd9900000
```

## configs/noblelte_defconfig
```kconfig
CONFIG_CROSS_COMPILE="aarch64-linux-gnu-"
CONFIG_EXYNOS_7420=y
CONFIG_SAMSUNG_NOBLELTE=y
```

## configs/p682lpn_defconfig
```kconfig
CONFIG_UMS9230=y
CONFIG_SIMPLE_FB=y
CONFIG_ITEL_P682LPN=y
CONFIG_TEXT_BASE=0x84500000
CONFIG_POSITION_INDEPENDENT=y
CONFIG_LINUX_KRNL_HEADER_IMG=y
CONFIG_PAYLOAD_ENTRY=0x90000000
CONFIG_RAMDISK_ENTRY=0xa0000000
```

## configs/pdx245_defconfig
```kconfig
CONFIG_POSITION_INDEPENDENT=y
CONFIG_LINUX_KRNL_HEADER_IMG=y
# CONFIG_COMPRESS_GZIP is not set
CONFIG_SM8650=y
CONFIG_SONY_PDX245=y
CONFIG_TEXT_BASE=0xe1bb0000
CONFIG_PAYLOAD_ENTRY=0x84000000
CONFIG_RAMDISK_ENTRY=0x90000000
```

## configs/pong_defconfig
```kconfig
CONFIG_POSITION_INDEPENDENT=y
CONFIG_LINUX_KRNL_HEADER_IMG=y
CONFIG_SM8450=y
CONFIG_NOTHING_PONG=y
CONFIG_TEXT_BASE=0xa8000000
CONFIG_PAYLOAD_ENTRY=0x80b900000
CONFIG_RAMDISK_ENTRY=0xb6915000
```

## configs/pw3_defconfig
```kconfig
CONFIG_TEXT_BASE=0x82000000
CONFIG_AMAZON_PW3=y
CONFIG_FREESCALE_IMX6SL=y
CONFIG_SIMPLE_FB=n
CONFIG_UART_DEBUG=y
CONFIG_PAYLOAD_ENTRY=0x90000000
CONFIG_RAMDISK_ENTRY=0x87000000
```

## configs/r0q_defconfig
```kconfig
CONFIG_POSITION_INDEPENDENT=y
CONFIG_SM8450=y
CONFIG_SAMSUNG_R0Q=y
CONFIG_TEXT_BASE=0x87000000
CONFIG_PAYLOAD_ENTRY=0x80b900000
CONFIG_RAMDISK_ENTRY=0xb6915000
```

## configs/r8s_defconfig
```kconfig
CONFIG_CROSS_COMPILE="aarch64-linux-gnu-"
CONFIG_EXYNOS_990=y
CONFIG_SAMSUNG_R8S=y
```

## configs/r9q_defconfig
```kconfig
CONFIG_POSITION_INDEPENDENT=y
CONFIG_SM8350=y
CONFIG_SAMSUNG_R9Q=y
CONFIG_SIMPLE_FB=y
CONFIG_TEXT_BASE=0x9ae00000
CONFIG_PAYLOAD_ENTRY=0xa0150000
CONFIG_RAMDISK_ENTRY=0xbae00000
CONFIG_LINUX_KRNL_HEADER_IMG=y
```

## configs/rmx3511_defconfig
```kconfig
CONFIG_UMS9230=y
CONFIG_SIMPLE_FB=y
CONFIG_REALME_RMX3511=y
CONFIG_LINUX_KRNL_HEADER_IMG=y
CONFIG_TEXT_BASE=0x80080000
CONFIG_PAYLOAD_ENTRY=0x90000000
CONFIG_RAMDISK_ENTRY=0xa0000000
```

## configs/spacewar_defconfig
```kconfig
CONFIG_POSITION_INDEPENDENT=y
CONFIG_LINUX_KRNL_HEADER_IMG=y
CONFIG_SM7325=y
CONFIG_NOTHING_SPACEWAR=y
CONFIG_TEXT_BASE=0x83600000
CONFIG_RAMDISK_ENTRY=0xadb6c000
CONFIG_PAYLOAD_ENTRY=0xc5100000
```

## configs/star2lte_defconfig
```kconfig
CONFIG_POSITION_INDEPENDENT=y
CONFIG_EXYNOS_9810=y
CONFIG_SAMSUNG_STAR2LTE=y
CONFIG_TEXT_BASE=0x87000000
CONFIG_PAYLOAD_ENTRY=0x90000000
CONFIG_RAMDISK_ENTRY=0x84000000
```

## configs/starlte_defconfig
```kconfig
CONFIG_POSITION_INDEPENDENT=y
CONFIG_EXYNOS_9810=y
CONFIG_SAMSUNG_STARLTE=y
CONFIG_TEXT_BASE=0x87000000
CONFIG_PAYLOAD_ENTRY=0x90000000
CONFIG_RAMDISK_ENTRY=0x84000000
CONFIG_FRAMEBUFFER_BASE=0xcc000000
CONFIG_FRAMEBUFFER_WIDTH=1440
CONFIG_FRAMEBUFFER_HEIGHT=2960
CONFIG_FRAMEBUFFER_STRIDE=4
```

## configs/taimen_defconfig
```kconfig
CONFIG_LINUX_KRNL_HEADER_IMG=y
# CONFIG_SIMPLE_FB is not set
CONFIG_UART_DEBUG=y
CONFIG_MSM8998=y
CONFIG_GOOGLE_TAIMEN=y
CONFIG_TEXT_BASE=0x80080000
CONFIG_PAYLOAD_ENTRY=0x95000000
CONFIG_RAMDISK_ENTRY=0x97000000
```

## configs/tundra_defconfig
```kconfig
CONFIG_POSITION_INDEPENDENT=y
CONFIG_LINUX_KRNL_HEADER_IMG=y
CONFIG_SM8350=y
CONFIG_MOTOROLA_TUNDRA=y
CONFIG_TEXT_BASE=0x87000000
CONFIG_PAYLOAD_ENTRY=0x90000000
CONFIG_RAMDISK_ENTRY=0xaeba8000
```

## configs/virt_defconfig
```kconfig
# CONFIG_SIMPLE_FB is not set
CONFIG_UART_DEBUG=y
CONFIG_QEMU_SOC_VIRT=y
CONFIG_QEMU_BOARD_VIRT=y
CONFIG_TEXT_BASE=0x40000000
CONFIG_PAYLOAD_ENTRY=0x45000000
CONFIG_RAMDISK_ENTRY=0x50000000
```

## configs/vita_defconfig
```kconfig
# CONFIG_COMPRESS_GZIP is not set
CONFIG_SONY_KERMIT=y
CONFIG_SONY_PSVITA=y
CONFIG_TEXT_BASE=0x44000000
CONFIG_PAYLOAD_ENTRY=0x45000000
CONFIG_RAMDISK_ENTRY=0x4A000000
```

## configs/x1s_defconfig
```kconfig
CONFIG_POSITION_INDEPENDENT=y
CONFIG_EXYNOS_990=y
CONFIG_SAMSUNG_X1S=y
CONFIG_TEXT_BASE=0x87000000
CONFIG_PAYLOAD_ENTRY=0x90000000
CONFIG_RAMDISK_ENTRY=0x84000000
CONFIG_FRAMEBUFFER_BASE=0xf1000000
CONFIG_FRAMEBUFFER_WIDTH=1440
CONFIG_FRAMEBUFFER_HEIGHT=3200
CONFIG_FRAMEBUFFER_STRIDE=4
```

## configs/x6710_defconfig
```kconfig
CONFIG_COMPRESS_GZIP=y
CONFIG_UART_DEBUG=n
CONFIG_SIMPLE_FB=y
CONFIG_MT6893=y
CONFIG_INFINIX_X6710=y
CONFIG_TEXT_BASE=0x40080000
CONFIG_RAMDISK_ENTRY=0x51100000
CONFIG_PAYLOAD_ENTRY=0x60000000
```

## configs/zero3_defconfig
```kconfig
CONFIG_CROSS_COMPILE="aarch64-linux-gnu-"
CONFIG_ALLWINNER_H616=y
CONFIG_ORANGEPI_ZERO3=y
CONFIG_SIMPLE_FB=n
```

## configs/zeroflte_defconfig
```kconfig
CONFIG_POSITION_INDEPENDENT=y
CONFIG_EXYNOS_7420=y
CONFIG_SAMSUNG_ZEROFLTE=y
CONFIG_TEXT_BASE=0x47000000
CONFIG_PAYLOAD_ENTRY=0x90000000
CONFIG_RAMDISK_ENTRY=0x44000000
CONFIG_FRAMEBUFFER_BASE=0xe2a00000
CONFIG_FRAMEBUFFER_WIDTH=1440
CONFIG_FRAMEBUFFER_HEIGHT=2560
CONFIG_FRAMEBUFFER_STRIDE=4
```

## drivers/timer/Kconfig
```kconfig
if TIMER
	config TIMER_MTK_CPUXGPT
		bool "Timer initialization for MediaTek CPUXGPT"
		depends on MEDIATEK_MCUSYS
		default n
		help
		  Some Mediatek platforms have a buggy ATF that doesn't enable
		  the ARM Architected Timers. Say Y here if you have a device
		  with one of those platforms.
endif
```
