## configs/qemu_defconfig
```kconfig
CONFIG_TEXT_BASE=0x40008000
CONFIG_EMBED_XNU=y
CONFIG_XNU_BLOB_LZ4=y
CONFIG_PAYLOAD_ENTRY=0x40801000
CONFIG_RAMDISK_ENTRY=0x7DF00000
CONFIG_COMPRESS_GZIP=n
CONFIG_LOGLEVEL=7
CONFIG_XNU_ENTRY_OFFSET=0xe68e0
CONFIG_XNU_PHYS_BASE=0x40800000
CONFIG_XNU_VIRT_BASE=0x80000000
CONFIG_XNU_MEMSIZE=0x3F800000
CONFIG_XNU_FB_BASE=0x50000000
CONFIG_XNU_FB_WIDTH=480
CONFIG_XNU_FB_HEIGHT=800
CONFIG_XNU_CMDLINE="-v keepsyms=1 kprintf=1 debug=0x14e"
CONFIG_XNU_CACHESLICE_TOP=0x7F000000
CONFIG_XNU_RAMDISK_PA=0x5F000000
CONFIG_QEMU_SOC_VIRT=y
CONFIG_QEMU_BOARD_VIRT_ARM=y
CONFIG_EARLYCON=y
CONFIG_LIBFDT=n
```

## configs/shennong_defconfig
```kconfig
CONFIG_POSITION_INDEPENDENT=y
CONFIG_LINUX_KRNL_HEADER_IMG=y
CONFIG_SM8650=y
CONFIG_XIAOMI_SHENNONG=y
CONFIG_TEXT_BASE=0xc0000000
CONFIG_PAYLOAD_ENTRY=0xa8000000
CONFIG_RAMDISK_ENTRY=0xb0000000
```

## configs/sunstone_defconfig
```kconfig
CONFIG_COMPRESS_GZIP=y
CONFIG_SIMPLE_FB=y
CONFIG_MT8188=y
CONFIG_AMAZON_SUNSTONE=y
CONFIG_TEXT_BASE=0x40080000
CONFIG_RAMDISK_ENTRY=0x51100000
CONFIG_PAYLOAD_ENTRY=0x60000000
```

## configs/tb373fu_defconfig
```kconfig
# CONFIG_COMPRESS_GZIP is not set
CONFIG_COMPRESS_LZ4=y
# CONFIG_LIBFDT is not set
CONFIG_MT6897=y
CONFIG_LENOVO_TB373FU=y
CONFIG_TEXT_BASE=0x40000000
CONFIG_PAYLOAD_ENTRY=0x60000000
CONFIG_RAMDISK_ENTRY=0x51100000
CONFIG_WATCHDOG=y
CONFIG_WDT_DISABLE_ON_BOOT=y
CONFIG_WDT_MEDIATEK=y
```

## configs/tetris_defconfig
```kconfig
CONFIG_POSITION_INDEPENDENT=y
# CONFIG_COMPRESS_GZIP is not set
CONFIG_COMPRESS_LZ4=y
# CONFIG_SIMPLE_FB is not set
CONFIG_EARLYCON=y
CONFIG_MT6878=y
CONFIG_NOTHING_TETRIS=y
CONFIG_TEXT_BASE=0x40000000
CONFIG_PAYLOAD_ENTRY=0x60000000
CONFIG_RAMDISK_ENTRY=0x51100000
CONFIG_WATCHDOG=y
CONFIG_WDT_DISABLE_ON_BOOT=y
CONFIG_WDT_MEDIATEK=y
```

## configs/troika_defconfig
```kconfig
CONFIG_POSITION_INDEPENDENT=y
# CONFIG_COMPRESS_GZIP is not set
CONFIG_EXYNOS_9610=y
CONFIG_MOTOROLA_TROIKA=y
CONFIG_TEXT_BASE=0x88000000
CONFIG_PAYLOAD_ENTRY=0x92000000
CONFIG_RAMDISK_ENTRY=0x84000000
```

## configs/v36bml_defconfig
```kconfig
CONFIG_MT6735=y
CONFIG_SIMPLE_FB=y
CONFIG_HTC_v36BML=y
CONFIG_LINUX_KRNL_HEADER_IMG=y
CONFIG_TEXT_BASE=0x40080000
CONFIG_PAYLOAD_ENTRY=0x43200000
CONFIG_RAMDISK_ENTRY=0xfd010000
```

## configs/waffle_defconfig
```kconfig
CONFIG_POSITION_INDEPENDENT=y
CONFIG_LINUX_KRNL_HEADER_IMG=y
# CONFIG_COMPRESS_GZIP is not set
CONFIG_SM8650=y
CONFIG_ONEPLUS_WAFFLE=y
CONFIG_TEXT_BASE=0xa8010000
CONFIG_PAYLOAD_ENTRY=0xa3200000
CONFIG_RAMDISK_ENTRY=0xb6f95000
```

## drivers/Kconfig
```kconfig
menu "Drivers"
	config EXYNOS_ACPM
		bool "Support for Samsung Exynos ACPM block"
		default n
		help
		    Say Y if you have a device with the Samsung Exynos ACPM block.

	config EXYNOS_SPEEDY
		bool "Support for Samsung Exynos SPEEDY bus"
		default n
		help
		    Say Y if you have a device with the Samsung Exynos SPEEDY bus.

	config EXYNOS_USBHOST3475
		bool "Support for bare-metal EHCI host on Exynos 3475"
		depends on SAMSUNG_J1XLTE
		default n
		help
		  Say Y to probe a USB mass-storage device on the SM-J120F's
		  OTG host port (PHY+EHCI enumeration, MBR dump).

	config EXYNOS_SDMMC3475
		bool "Support for bare-metal dw_mmc SD host on Exynos 3475"
		depends on SAMSUNG_J1XLTE
		default n
		help
		  Say Y to identify the SM-J120F's removable SD card (dwmmc2)
		  and report its total size.  Read-only: only identify/CSD
		  commands, no data phase, no writes, never touches eMMC.

	config EXYNOS_SD_FAT
		bool "Read-only FAT32 filesystem on the SD card"
		depends on EXYNOS_SDMMC3475
		default n
		help
		  Say Y to parse the SD card's MBR + FAT32 boot sector and expose
		  sd_fat_read() for loading embedded boot blobs (Image/dtb/
		  ramdisk/cacheslice) without a full memory block layer.

	config EXYNOS_SD_BOOT
		bool "Boot XNU from the SD card (raw blobs)"
		depends on EXYNOS_SD_FAT && EMBED_XNU
		default n
		help
		  Say Y to load plain (uncompressed) Image/dtb/ramdisk straight
		  from the FAT32 SD card into their final physical addresses and
		  jump into XNU, skipping the embedded .payload LZ4/RDSC decode
		  path.  Falls back to the embedded payload if no card is present.

	config J1UART_MIRROR
		bool "Append j1uart=1 to the SD-path kernel command line"
		depends on EXYNOS_SD_BOOT
		default n
		help
		  Emulator-only diagnostic: the XNU console mirror
		  (pe_exynos_console_putc, j1uart bootarg) duplicates every
		  kprintf character to UART2, which the J1 bring-up QEMU
		  machine exposes on -serial.  The phone defconfig leaves
		  this off so the panel console stays the only sink.

	config MEDIATEK_MCUSYS
		bool "Support for MediaTek MCUSYS"
		depends on MEDIATEK
		default n
		help
		  Say Y if you have a device with a MediaTek SoC and need to use
		  hardware behind MCUSYS.

	menuconfig TIMER
		bool "Timer support"
		default n
		help
		  Say Y here to enable support for timer drivers. Enabling this
		  option alone won't add any code to the resulting binary.

source "drivers/timer/Kconfig"

endmenu
```

## drivers/watchdog/Kconfig
```kconfig
menuconfig WATCHDOG
	bool "Watchdog support"
	default n
	help
	  Say Y here to enable support for watchdog drivers. Enabling this
	  option alone won't add any code to the resulting binary.

if WATCHDOG
	config WDT_DISABLE_ON_BOOT
		bool "Disable watchdog timer on boot"
		default y
		help
		  Say Y if you want to disable the watchdog timer on startup.
		  While this is obviously useful for end-users, developers may
		  want to leave this on to avoid holding down the power button
		  every time.

	config WDT_MEDIATEK
		bool "Generic MediaTek watchdog driver"
		default n
		help
		  Most aarch64 MediaTek platforms use this style of watchdog
		  timer.

	config WDT_SP805
		bool "ARM SP805 watchdog driver"
		default n
		help
		  ARM Primecell SP805 Watchdog timer.
endif
```

## lib/Kconfig
```kconfig
menu "Libraries"
	config SIMPLE_FB
		bool "Support for Simple Framebuffer"
		default y
		help
		  Say Y if you want to have Framebuffer output.

	config EARLYCON
		bool "Support for UART early console"
		default n
		help
		  Say Y if you want to have UART early console output. Keep
		  in mind that your board files need to provide uart_puts
		  functionality in order for this to work.

	config LIBFDT
		bool "Support for libfdt"
		default y
		help
		  Say Y if you want to have libfdt features.

	config FDT_BUF_SIZE
		int "Size of the static buffer for the Flattened Device Tree"
		default 500000
		depends on LIBFDT
		help
		  This option specifies the size (in bytes) of the buffer used for DTB modifying. The default value of 500 KB should be sufficient even for downstream device trees.

	config FDT_BUF_ADDR
		hex "Address of the buffer for the Flattened Device Tree"
		default 0x0
		depends on LIBFDT
		help
		  If set, the patched DTB is placed at this address instead of a
		  static buffer inside uniLoader. Use this if the kernel overwrites
		  uniLoader before reading the DTB, like an ARMv7 zImage that
		  decompresses over it.
endmenu
```
