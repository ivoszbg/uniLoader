## soc/Kconfig
```kconfig
config APPLE_SILICON
	bool
	default n

config EXYNOS
	bool
	default n

config FREESCALE
	bool
	default n

config MEDIATEK
	bool
	default n

config QEMU
	bool
	default n

config QUALCOMM
	bool
	default n

 choice
	prompt "SoC Support"

	config APPLE_T7000
		bool "Support for Apple T7000"
		select APPLE_SILICON
		help
		  Say Y if your device uses Apple T7000 SoC

	config APPLE_T8010
		bool "Support for Apple T8010"
		select APPLE_SILICON
		help
		  Say Y if your device uses Apple T8010 SoC

	config EXYNOS_1280
		bool "Support for Exynos 1280"
		select EXYNOS
		help
		  Say Y if your device uses Samsung Exynos1280 SoC

	config EXYNOS_2200
		bool "Support for Exynos 2200"
		select EXYNOS
		help
		  Say Y if your device uses Samsung Exynos2200 SoC

	config EXYNOS_3830
		bool "Support for Exynos 850"
		select EXYNOS
		help
		  Say Y if your device uses Samsung Exynos850 SoC

	config EXYNOS_7420
		bool "Support for Exynos 7420"
		select EXYNOS
		help
		  Say Y if your device uses Samsung Exynos7420 SoC

	config EXYNOS_7570
		bool "Support for Exynos 7570"
		select EXYNOS
		help
		  Say Y if your device uses Samsung Exynos7570 SoC

	config EXYNOS_7580
		bool "Support for Exynos 7580"
		select EXYNOS
		help
		  Say Y if your device uses Samsung Exynos7580 SoC

	config EXYNOS_7885
		bool "Support for Exynos 7885"
		select EXYNOS
		help
		  Say Y if your device uses Samsung Exynos7885 SoC

	config EXYNOS_8890
		bool "Support for Exynos 8890"
		select EXYNOS
		help
		  Say Y if your device uses Samsung Exynos8890 SoC

	config EXYNOS_8895
		bool "Support for Exynos 8895"
		select EXYNOS
		help
		  Say Y if your device uses Samsung Exynos8895 SoC

	config EXYNOS_9610
		bool "Support for Exynos 9610"
		select EXYNOS
		help
		  Say Y if your device uses Samsung Exynos9610 SoC

	config EXYNOS_9810
		bool "Support for Exynos 9810"
		select EXYNOS
		help
		  Say Y if your device uses Samsung Exynos9810 SoC
		  
	config EXYNOS_990
		bool "Support for Exynos 990"
		select EXYNOS
		help
		  Say Y if your device uses Samsung Exynos990 SoC

	config MT6735
		bool "Support for Mediatek MT6735"
		select MEDIATEK
		help
		  Say Y if your device uses Mediatek MT6735 SoC

	config MT6765
		bool "Support for Mediatek MT6765"
		select MEDIATEK
		help
		  Say Y if your device uses Mediatek MT6765 SoC

	config MT6785
		bool "Support for Mediatek MT6785"
		select MEDIATEK
		help
		  Say Y if your device uses Mediatek MT6785 SoC
	
	config MT6833
		bool "Support for Mediatek MT6833"
		select MEDIATEK
		help
		  Say Y if your device uses Mediatek MT6833 SoC

	config MT6877
		bool "Support for Mediatek MT6877"
		select MEDIATEK
		help
		  Say Y if your device uses Mediatek MT6877 SoC

	config MT6878
		bool "Support for Mediatek MT6878"
		select MEDIATEK
		help
		  Say Y if your device uses Mediatek MT6878 SoC
	
	config MT6893
		bool "Support for Mediatek MT6893"
		select MEDIATEK
		help
		  Say Y if your device uses Mediatek MT6893 SoC

	config QC32_8916
		bool "Support for QUALCOMM MSM8916"
		select QUALCOMM
		help
		  Say Y if your device uses this Qualcomm SoC

	config SM8450
		bool "Support for QUALCOMM SM8450"
		select QUALCOMM
		help
		  Say Y if your device uses this Qualcomm SoC
	
	config QEMU_SOC_VIRT
		bool "Support for QEMU virt aarch64 SoC"
		select QEMU
		help
		  Say Y if you are using the generic QEMU emulation
		  platform target - virt.

	config MSM8998
		bool "Support for Qualcomm Snapdragon 835"
		select QUALCOMM
		help
		  Say Y if your device uses Qualcomm MSM8998

	config FREESCALE_IMX6SL
		bool "Support for Freescale i.MX6SL"
		select FREESCALE
		help
		  Say Y if your device uses i.MX6SL
 endchoice
```
