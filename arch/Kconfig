## arch/Kconfig
```kconfig
menu "Architecture"
	config POSITION_INDEPENDENT
		bool "Code relocation during early boot"
		help
		  Say Y if your previous bootloader loads uniLoader at an unknown
		  or different address every time.

	config LINUX_KRNL_HEADER_IMG
		bool "Append Linux header"
		help
		  Say Y if your want to appened a linux kernel image header to
		  uniLoader.
endmenu
```

## board/Kconfig
```kconfig
menu "Device Support"
	config AMAZON_PW3
		bool "Support for Amazon Kindle Paperwhite 3"
		default n
		depends on FREESCALE_IMX6SL
		help
		  Say Y if you want to include support for Amaozn Kindle
		  Paperwhite 3

	config APPLE_N61AP
		bool "Support for Apple iPhone 6"
		default n
		depends on APPLE_T7000
		help
		  Say Y if you want to include support for iPhone 6

	config GOOGLE_TAIMEN
		bool "Support for Google Pixel 2 XL"
		default n
		depends on MSM8998
		help
		  Say Y if you want to include support for Pixel 2 XL

	config INFINIX_X6710
		bool "Support for Infinix Note 30 VIP"
		default n
		depends on MT6893
		help
		  Say Y if you want to include support for Infinix Note 30 VIP

	config NOTHING_TETRIS
		bool "Support for CMF Phone 1"
		default n
		depends on MT6878
		help
		  Say Y if you want to include support for CMF Phone 1

	config NOKIA_ESSENTIAL
		bool "Support for Nokia 3"
		default n
		depends on MT6735
		help
		  Say Y if you want to include support for Nokia 3

	config NOTHING_TETRIS_DISABLE_WDT
		bool "Disable the watchdog timer on startup"
		default y
		depends on NOTHING_TETRIS
		help
		  Say Y if you want to disable the watchdog timer on startup
		  on this board. While this is obviously useful for end-users,
		  developers may want to leave this on to avoid holding down
		  the power button every time.

	config QEMU_BOARD_VIRT
		bool "Support for QEMU virt platform (aarch64)"
		default n
		depends on QEMU_SOC_VIRT
		help
		  Say Y if you are using the generic QEMU emulation
		  platform target - virt.

	config SAMSUNG_A105F
		bool "Support for Samsung Galaxy A10"
		default n
		depends on EXYNOS_7885
		help
		   Say Y if you want to include support for Samsung Galaxy A10

        config SAMSUNG_A127F
		bool "Support for Samsung Galaxy A12 Nacho"
		default n
		depends on EXYNOS_3830
		help
		  Say Y if you want to include support for Samsung Galaxy A12 Nacho

	config SAMSUNG_A3XELTE
		bool "Support for Samsung Galaxy A3 2016"
		default n
		depends on EXYNOS_7580
		help
		  Say Y if you want to include support for Samsung Galaxy A3 2016

	config SAMSUNG_A336B
		bool "Support for Samsung Galaxy A33"
		default n
		depends on EXYNOS_1280
		help
		  Say Y if you want to include support for Samsung Galaxy A33

	config SAMSUNG_C1S
		bool "Support for Samsung Galaxy Note20"
		default n
		depends on EXYNOS_990
		help
		  Say Y if you want to include support for Samsung Galaxy Note20

	config SAMSUNG_G0S
		bool "Support for Samsung Galaxy S22+"
		default n
		depends on EXYNOS_2200
		help
		  Say Y if you want to include support for Samsung Galaxy S22+

	config SAMSUNG_HEROLTE
		bool "Support for Samsung Galaxy S7"
		default n
		depends on EXYNOS_8890
		help
		  Say Y if you want to include support for Samsung Galaxy S7

	config SAMSUNG_NOBLELTE
		bool "Support for Samsung Galaxy Note5"
		default n
		depends on EXYNOS_7420
		help
		  Say Y if you want to include support for Samsung Galaxy Note5

	config SAMSUNG_JACKPOTLTE
		bool "Support for Samsung Galaxy A8 (2018)"
		default n
		depends on EXYNOS_7885
		help
		  Say Y if you want to include support for Samsung Galaxy A8 (2018)

	config SAMSUNG_ZEROFLTE
		bool "Support for Samsung Galaxy S6"
		default n
		depends on EXYNOS_7420
		help
		  Say Y if you want to include support for Samsung Galaxy S6

	config SAMSUNG_DREAMLTE
		bool "Support for Samsung Galaxy S8"
		default n
		depends on EXYNOS_8895
		help
		  Say Y if you want to include support for Samsung Galaxy S8

	config SAMSUNG_STARLTE
		bool "Support for Samsung Galaxy S9"
		default n
		depends on EXYNOS_9810
		help
		  Say Y if you want to include support for Samsung Galaxy S9
		  
	config SAMSUNG_X1S
		bool "Support for Samsung Galaxy S20"
		default n
		depends on EXYNOS_990
		help
		  Say Y if you want to include support for Samsung Galaxy S20

	config SAMSUNG_J4LTE
		bool "Support for Samsung Galaxy J4 2018"
		default n
		depends on EXYNOS_7570
		help
		  Say Y if you want to include arm64 support for Samsung Galaxy J4 2018

	config SAMSUNG_J5LTE
		bool "Support for Samsung Galaxy J5 2015"
		default n
		depends on QC32_8916
		help
		  Say Y if you want to include arm32 support for Samsung Galaxy J5 2015

	config SAMSUNG_GTA4XL
		bool "Support for Samsung Galaxy Tab S6 Lite"
		default n
		depends on EXYNOS_9610
		help
		  Say Y if you want to include support for Samsung Galaxy Tab S6 Lite

	config SAMSUNG_R0Q
		bool "Support for Samsung Galaxy S22"
		default n
		depends on SM8450
		help
		  Say Y if you want to include support for Samsung Galaxy S22

	config SAMSUNG_R8S
		bool "Support for Samsung Galaxy S20 FE"
		default n
		depends on EXYNOS_990
		help
		  Say Y if you want to include support for Samsung Galaxy S20 FE

	config XIAOMI_BLOSSOM
		bool "Support for Xiaomi Blossom devices"
		default n
		depends on MT6765
		help
		  Say Y if you want to include support for Xiaomi Blossom 
		  devices (R Vendor only):
		  Redmi 9A, Redmi 9I, Redmi 9AT, Redmi 10A, Redmi 9A Sport, Redmi 9I Sport,
		  Poco C3, Poco C31, Redmi 9C, Redmi 9C NFC, Redmi 9 India, Redmi 9 Active.

	config XIAOMI_CAMELLIA
		bool "Support for Xiaomi Poco M3 Pro 5G"
		default n
		depends on MT6833
		help
		  Say Y if you want to include support for Poco M3 Pro 5G

	config VOLLA_ALGIZ
		bool "Support for Volla Phone Quintus"
		default n
		depends on MT6877
		help
		  Say Y if you want to include support for Volla Phone Quintus

	config XIAOMI_BEGONIA
		bool "Support for Redmi Note 8 Pro"
		default n
		depends on MT6785
		help
		  Say Y if you want to include support for Redmi Note 8 Pro
endmenu

menu "Device Specific Addresses"

	config TEXT_BASE
		hex "UniLoader Text Base"
		default 0x0

	config PAYLOAD_ENTRY
		hex "Payload Entry Address"
		default 0x50000000 if NOTHING_TETRIS
		default 0x050000000 if SAMSUNG_J4LTE
		default 0x090000000 if SAMSUNG_J5LTE
		default 0x60000000 if VOLLA_ALGIZ
		default 0x50000000 if XIAOMI_BEGONIA

	config RAMDISK_ENTRY
		hex "Ramdisk Entry Address"
		default 0x40000000 if NOTHING_TETRIS
		default 0x51100000 if VOLLA_ALGIZ
		default 0x48000000 if XIAOMI_BEGONIA
endmenu
```

## configs/a105f_defconfig
```kconfig
CONFIG_EXYNOS_7885=y
CONFIG_SAMSUNG_A105F=y
CONFIG_PAYLOAD_ENTRY=0x90000000
CONFIG_RAMDISK_ENTRY=0x84000000
CONFIG_FRAMEBUFFER_BASE=0xec000000
CONFIG_FRAMEBUFFER_WIDTH=720
CONFIG_FRAMEBUFFER_HEIGHT=1520
CONFIG_FRAMEBUFFER_STRIDE=4
```

## configs/a127f_defconfig
```kconfig
CONFIG_EXYNOS_3830=y
CONFIG_SAMSUNG_A127F=y
CONFIG_PAYLOAD_ENTRY=0x90008000
CONFIG_RAMDISK_ENTRY=0x82000000
CONFIG_FRAMEBUFFER_BASE=0xfa000000
CONFIG_FRAMEBUFFER_WIDTH=720
CONFIG_FRAMEBUFFER_HEIGHT=1600
CONFIG_FRAMEBUFFER_STRIDE=4
```

## configs/a12s_defconfig
```kconfig
CONFIG_EXYNOS_3830=y
CONFIG_SAMSUNG_A12S=y
CONFIG_PAYLOAD_ENTRY=0x90008000
CONFIG_RAMDISK_ENTRY=0x82000000
CONFIG_FRAMEBUFFER_BASE=0xfa000000
CONFIG_FRAMEBUFFER_WIDTH=720
CONFIG_FRAMEBUFFER_HEIGHT=1600
CONFIG_FRAMEBUFFER_STRIDE=4
```

## configs/a135f_defconfig
```kconfig
CONFIG_POSITION_INDEPENDENT=y
CONFIG_EXYNOS_3830=y
CONFIG_SAMSUNG_A135F=y
CONFIG_TEXT_BASE=0x87000000
CONFIG_PAYLOAD_ENTRY=0x90000000
CONFIG_RAMDISK_ENTRY=0x84000000
CONFIG_FRAMEBUFFER_BASE=0xfa000000
CONFIG_FRAMEBUFFER_WIDTH=1080
CONFIG_FRAMEBUFFER_HEIGHT=2408
CONFIG_FRAMEBUFFER_STRIDE=4
```

## configs/a305f_defconfig
```kconfig
CONFIG_POSITION_INDEPENDENT=y
CONFIG_SIMPLE_FB=y
CONFIG_EXYNOS_7885=y
CONFIG_SAMSUNG_A305F=y
CONFIG_TEXT_BASE=0x87000000
CONFIG_PAYLOAD_ENTRY=0x90000000
CONFIG_RAMDISK_ENTRY=0x89000000
CONFIG_FRAMEBUFFER_BASE=0xec000000
CONFIG_FRAMEBUFFER_WIDTH=1080
CONFIG_FRAMEBUFFER_HEIGHT=2340
CONFIG_FRAMEBUFFER_STRIDE=4
```

## configs/a336b_defconfig
```kconfig
CONFIG_EXYNOS_1280=y
CONFIG_SAMSUNG_A336B=y
CONFIG_PAYLOAD_ENTRY=0x90000000
CONFIG_RAMDISK_ENTRY=0x84000000
CONFIG_FRAMEBUFFER_BASE=0xfa200000
CONFIG_FRAMEBUFFER_WIDTH=1080
CONFIG_FRAMEBUFFER_HEIGHT=2400
CONFIG_FRAMEBUFFER_STRIDE=4
```

## configs/a33x_defconfig
```kconfig
CONFIG_CROSS_COMPILE="aarch64-linux-gnu-"
CONFIG_EXYNOS_1280=y
CONFIG_SAMSUNG_A33X=y
```

## configs/a3xelte_defconfig
```kconfig
CONFIG_EXYNOS_7580=y
CONFIG_SAMSUNG_A3XELTE=y
CONFIG_TEXT_BASE=0x40205000
CONFIG_PAYLOAD_ENTRY=0x90000000
CONFIG_RAMDISK_ENTRY=0x84000000
```

## configs/a40_defconfig
```kconfig
CONFIG_CROSS_COMPILE="aarch64-linux-gnu-"
CONFIG_EXYNOS_7885=y
CONFIG_SAMSUNG_A40=y
CONFIG_PAYLOAD_ENTRY=0x90000000
CONFIG_RAMDISK_ENTRY=0x89000000
CONFIG_TEXT_BASE=0x87000000
CONFIG_FRAMEBUFFER_BASE=0x0ec000000
CONFIG_FRAMEBUFFER_WIDTH=1080
CONFIG_FRAMEBUFFER_HEIGHT=2340
CONFIG_FRAMEBUFFER_STRIDE=4
CONFIG_POSITION_INDEPENDENT=y
CONFIG_SIMPLE_FB=y
```

## configs/agassi2_defconfig
```kconfig
CONFIG_COMPRESS_GZIP=y
CONFIG_SIMPLE_FB=y
CONFIG_HI6250=y
CONFIG_HUAWEI_AGASSI2=y
CONFIG_TEXT_BASE=0x00480000
CONFIG_PAYLOAD_ENTRY=0x0e200000
CONFIG_RAMDISK_ENTRY=0x08000000
CONFIG_RAMDISK_NO_COPY=y
```

## configs/c1s_defconfig
```kconfig
CONFIG_POSITION_INDEPENDENT=y
CONFIG_EXYNOS_990=y
CONFIG_SAMSUNG_C1S=y
CONFIG_TEXT_BASE=0x87000000
CONFIG_PAYLOAD_ENTRY=0x90000000
CONFIG_RAMDISK_ENTRY=0x84000000
CONFIG_FRAMEBUFFER_BASE=0xf1000000
CONFIG_FRAMEBUFFER_WIDTH=1080
CONFIG_FRAMEBUFFER_HEIGHT=2400
CONFIG_FRAMEBUFFER_STRIDE=4
```

## configs/camellia_defconfig
```kconfig
CONFIG_COMPRESS_GZIP=y
CONFIG_UART_DEBUG=y
CONFIG_SIMPLE_FB=y
CONFIG_MT6833=y
CONFIG_XIAOMI_CAMELLIA=y
CONFIG_TEXT_BASE=0x40080000
CONFIG_RAMDISK_ENTRY=0x51100000
CONFIG_PAYLOAD_ENTRY=0x60000000
```

## configs/checkers_defconfig
```kconfig
CONFIG_MT8163=y
CONFIG_SIMPLE_FB=y
CONFIG_AMAZON_CHECKERS=y
CONFIG_TEXT_BASE=0x40080000
CONFIG_PAYLOAD_ENTRY=0x50000000
CONFIG_RAMDISK_ENTRY=0x60000000
```

## configs/d2s_defconfig
```kconfig
CONFIG_CROSS_COMPILE="aarch64-linux-gnu-"
CONFIG_EXYNOS_9825=y
CONFIG_SAMSUNG_D2S=y
```

## configs/essential_defconfig
```kconfig
CONFIG_MT6735=y
CONFIG_NOKIA_ESSENTIAL=y
CONFIG_TEXT_BASE=0x40080000
CONFIG_PAYLOAD_ENTRY=0x50000000
CONFIG_RAMDISK_ENTRY=0x44000000
CONFIG_MEDIATEK_MCUSYS=y
CONFIG_TIMER=y
CONFIG_TIMER_MTK_CPUXGPT=y
```

## configs/g0s_defconfig
```kconfig
CONFIG_POSITION_INDEPENDENT=y
CONFIG_EXYNOS_2200=y
CONFIG_EXYNOS_ACPM=y
CONFIG_SAMSUNG_G0S=y
CONFIG_TEXT_BASE=0x87000000
CONFIG_PAYLOAD_ENTRY=0x90000000
CONFIG_RAMDISK_ENTRY=0x84000000
```

## configs/heartbs_defconfig
```kconfig
CONFIG_CROSS_COMPILE="aarch64-linux-gnu-"
CONFIG_EXYNOS_W920=y
CONFIG_SAMSUNG_HEARTBS_44=y
CONFIG_FB_FIRST_LINE_OFFSET=6
```

## configs/herolte_defconfig
```kconfig
CONFIG_POSITION_INDEPENDENT=y
CONFIG_EXYNOS_8890=y
CONFIG_SAMSUNG_HEROLTE=y
CONFIG_TEXT_BASE=0x87000000
CONFIG_PAYLOAD_ENTRY=0x90000000
CONFIG_RAMDISK_ENTRY=0x84000000
```

## configs/j4lte_defconfig
```kconfig
CONFIG_POSITION_INDEPENDENT=y
CONFIG_CROSS_COMPILE="aarch64-linux-gnu-"
CONFIG_EXYNOS_7570=y
CONFIG_SAMSUNG_J4LTE=y
CONFIG_TEXT_BASE=0x47000000
CONFIG_PAYLOAD_ENTRY=0x50000000
CONFIG_RAMDISK_ENTRY=0x42000000
```

## configs/j5lte_defconfig
```kconfig
CONFIG_TEXT_BASE=0x80008000
CONFIG_LINUX_KRNL_HEADER_IMG=y
CONFIG_PAYLOAD_ENTRY=0x90000000
CONFIG_RAMDISK_ENTRY=0x84000000
CONFIG_SAMSUNG_J5LTE=y
CONFIG_QC32_8916=y
```

## configs/jackpotlte_defconfig
```kconfig
CONFIG_POSITION_INDEPENDENT=y
CONFIG_EXYNOS_7885=y
CONFIG_SAMSUNG_JACKPOTLTE=y
CONFIG_TEXT_BASE=0x87000000
CONFIG_PAYLOAD_ENTRY=0x90000000
CONFIG_RAMDISK_ENTRY=0x84000000
CONFIG_FRAMEBUFFER_BASE=0xec000000
CONFIG_FRAMEBUFFER_WIDTH=1080
CONFIG_FRAMEBUFFER_HEIGHT=2200
CONFIG_FRAMEBUFFER_STRIDE=4
```

## configs/jflte_defconfig
```kconfig
CONFIG_CROSS_COMPILE="arm-none-eabi-"
CONFIG_SAMSUNG_JFLTE=y
CONFIG_QC32_APQ8064=y
```

## configs/li7_defconfig
```kconfig
CONFIG_COMPRESS_GZIP=y
CONFIG_SIMPLE_FB=y
CONFIG_MT6789=y
CONFIG_TECNO_LI7=y
CONFIG_TEXT_BASE=0x40000000
CONFIG_RAMDISK_ENTRY=0x41000000
CONFIG_PAYLOAD_ENTRY=0x48000000
```
