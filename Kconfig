## Kconfig
```kconfig
#
# For a description of the syntax of this configuration file,
# see Documentation/kbuild/kconfig-language.txt.
#
mainmenu "uniLoader Configuration"

source "arch/Kconfig"

menu "Building options"
	config CROSS_COMPILE
		string "Cross-compiler tool prefix"
		help
		  Same as running 'make CROSS_COMPILE=prefix-' but stored for
		  default make runs in this kernel build directory.  You don't
		  need to set this unless you want the configured kernel build
		  directory to select the cross-compiler automatically.

	config LOGLEVEL
		int "Verbosity of logs"
		default 7

	config COMPRESS_GZIP
		bool "Compress the uniLoader image with gzip"
		default y
		help
		  Select this if you want to use gzip to compress the final uniLoader image.

	config COMPRESS_LZ4
		bool "Compress the uniLoader image with lz4"
		default n
		help
		  Select this if you want to use lz4 to compress the final uniLoader image.
		  This is required on some new MediaTek devices.

	config EMBED_LINUX
		bool "Embed linux kernel and device tree"
		default y
		help
		  Select this if you want uniLoader to load a linux kernel and device tree

	config KERNEL_PATH
		string "Path to kernel image"
		depends on EMBED_LINUX
		default blob/Image
		help
		  Path to the kernel, which is going to get embedded to uniLoader

	config DT_PATH
		string "Path to device tree image"
		depends on EMBED_LINUX
		default blob/dtb
		help
		  Path to the device tree, which is going to get embedded to uniLoader

	config RAMDISK_PATH
		string "Path to ramdisk image"
		depends on EMBED_LINUX
		default blob/ramdisk
		help
		  Path to the ramdisk, which is going to get embedded to uniLoader
	
	config RAMDISK_NO_COPY
		bool "Do not copy ramdisk"
		depends on EMBED_LINUX
		default n
		help
		  Select this if the bootloader copies the ramdisk itself

	config EMBED_XNU
		bool "Embed XNU kernel (darwin-on-arm) and Apple device tree"
		default n
		help
		  Select this if you want uniLoader to load a darwin-on-arm XNU
		  kernel with an Apple-format flattened device tree. Takes
		  precedence over EMBED_LINUX.

if EMBED_XNU

config XNU_BLOB_LZ4
		bool "Embedded XNU blob is a raw LZ4 block"
		default n

config XNU_ENTRY_OFFSET
		hex "Offset of __start inside the flat XNU image"
		default 0xdf8e0

config XNU_PHYS_BASE
		hex "Physical base XNU is told about (kernel loads at +0x1000)"
		default 0x22000000

config XNU_VIRT_BASE
		hex "Virtual base XNU maps physical memory at"
		default 0x80000000

config XNU_MEMSIZE
		hex "Memory size handed to XNU (must not cover the framebuffer)"
		default 0x35E00000

config XNU_FB_BASE
		hex "Framebuffers physical address left running by S-Boot"
		default 0x57E05000

config XNU_FB_WIDTH
		int "Framebuffer scanout width in pixels"
		default 540

config XNU_FB_HEIGHT
		int "Framebuffer scanout height in pixels"
		default 960

config XNU_CMDLINE
		string "Kernel command line (boot args)"
		default "-v keepsyms=1 kprintf=1 debug=0x14e"

config XNU_CACHESLICE_TOP
		hex "Highest physical address the embedded DSC slices may use"
		default 0x55E00000
		help
		  BRING-UP (J1): cacheslice decode must stay below the top of
		  the kernel's RAM window (CONFIG_XNU_MEMSIZE) or the kernel
		  cannot map/feed the tail pages.  Larger amounts of RAM (e.g.
		  QEMU virt) raise this.

config XNU_EMBED_CACHESLICE
	bool "Embed the dyld shared cache in the loader image"
	default y
		help
		  The dyld shared cache is ~154 MiB.  Boards that read it from
		  the SD card (j1xlte) do not need an embedded copy: turn this
		  off to keep the loader - and therefore boot.img - small.
		  Leave it on for boards that boot purely from the embedded
		  payload (QEMU virt), where it is the only source of the cache.

config XNU_RAMDISK_PA
		hex "Fixed physical address to decode the RDSC ramdisk at"
		default 0x0
		help
		  BRING-UP (QEMU): if non-zero, decode the RDSC ramdisk at this
		  fixed address instead of top-of-RAM.  A top-of-RAM ramdisk
		  pushes topOfKernelData (hence the kernel's first_avail) up,
		  collapsing the free-page pool; with a large ramdisk the pool
		  can hit zero before the first exec UPL (infinite VM_PAGE_WAIT).

endif

endmenu

source "drivers/Kconfig"

source "lib/Kconfig"

source "soc/Kconfig"

source "board/Kconfig"
```

## configs/a13_defconfig
```kconfig
CONFIG_POSITION_INDEPENDENT=y
CONFIG_EXYNOS_3830=y
CONFIG_SAMSUNG_A13=y
CONFIG_TEXT_BASE=0x87000000
CONFIG_PAYLOAD_ENTRY=0x90000000
CONFIG_RAMDISK_ENTRY=0x84000000
```

## configs/a145f_defconfig
```kconfig
CONFIG_SAMSUNG_A145F=y
CONFIG_EXYNOS_3830=y
CONFIG_POSITION_INDEPENDENT=y
CONFIG_LINUX_KRNL_HEADER_IMG=y
CONFIG_SIMPLE_FB=y
CONFIG_TEXT_BASE=0xa0000000
CONFIG_PAYLOAD_ENTRY=0x80200000
CONFIG_RAMDISK_ENTRY=0x84000000
```

## configs/a14m_defconfig
```kconfig
CONFIG_COMPRESS_GZIP=y
CONFIG_MT6768=y
CONFIG_SAMSUNG_A14M=y
CONFIG_TEXT_BASE=0x40080000
CONFIG_PAYLOAD_ENTRY=0x60000000
CONFIG_RAMDISK_ENTRY=0x47c80000
```

## configs/a20e_defconfig
```kconfig
CONFIG_EXYNOS_7885=y
CONFIG_SAMSUNG_A20E=y
CONFIG_PAYLOAD_ENTRY=0x90000000
CONFIG_RAMDISK_ENTRY=0x84000000
CONFIG_TEXT_BASE=0x87000000
CONFIG_POSITION_INDEPENDENT=y
```

## configs/a21s_defconfig
```kconfig
CONFIG_EXYNOS_3830=y
CONFIG_SAMSUNG_A21S=y
CONFIG_TEXT_BASE=0x80080000
CONFIG_PAYLOAD_ENTRY=0x90000000
CONFIG_RAMDISK_ENTRY=0x84000000
```

## configs/a50_defconfig
```kconfig
CONFIG_POSITION_INDEPENDENT=y
CONFIG_LINUX_KRNL_HEADER_IMG=y
CONFIG_RAMDISK_NO_COPY=y
CONFIG_EXYNOS_9610=y
CONFIG_SAMSUNG_A50=y
CONFIG_TEXT_BASE=0x88000000
CONFIG_PAYLOAD_ENTRY=0x90000000
CONFIG_RAMDISK_ENTRY=0x84000000
```

## configs/a71_defconfig
```kconfig
CONFIG_POSITION_INDEPENDENT=y
CONFIG_LINUX_KRNL_HEADER_IMG=y
CONFIG_SM7150=y
CONFIG_SAMSUNG_A71=y
CONFIG_TEXT_BASE=0xa4c00000
CONFIG_PAYLOAD_ENTRY=0xaa200000
CONFIG_RAMDISK_ENTRY=0xa1c17000
```

## configs/beyond1lte_defconfig
```kconfig
CONFIG_POSITION_INDEPENDENT=y
CONFIG_EXYNOS_DECON=y
CONFIG_EXYNOS_9820=y
CONFIG_SAMSUNG_BEYOND1LTE=y
CONFIG_TEXT_BASE=0x89000000
CONFIG_PAYLOAD_ENTRY=0x90000000
CONFIG_RAMDISK_ENTRY=0x84000000
```

## configs/daisy_defconfig
```kconfig
CONFIG_LINUX_KRNL_HEADER_IMG=y
CONFIG_MSM8953=y
CONFIG_XIAOMI_DAISY=y
CONFIG_TEXT_BASE=0x40080000
CONFIG_PAYLOAD_ENTRY=0x50000000
CONFIG_RAMDISK_ENTRY=0x44000000
```

## configs/dreamlte_defconfig
```kconfig
CONFIG_POSITION_INDEPENDENT=y
# CONFIG_COMPRESS_GZIP is not set
CONFIG_EXYNOS_8895=y
CONFIG_EXYNOS_SPEEDY=y
CONFIG_SAMSUNG_DREAMLTE=y
CONFIG_TEXT_BASE=0x87000000
CONFIG_PAYLOAD_ENTRY=0x90000000
CONFIG_RAMDISK_ENTRY=0x84000000
```

## configs/froggerpro_defconfig
```kconfig
CONFIG_POSITION_INDEPENDENT=y
CONFIG_LINUX_KRNL_HEADER_IMG=y
# CONFIG_COMPRESS_GZIP is not set
CONFIG_SIMPLE_FB=y
CONFIG_SM7750=y
CONFIG_NOTHING_FROGGERPRO=y
CONFIG_TEXT_BASE=0x9f000000
CONFIG_PAYLOAD_ENTRY=0xb8200000
CONFIG_RAMDISK_ENTRY=0xb7000000
```

## configs/ginkgo_defconfig
```kconfig
CONFIG_POSITION_INDEPENDENT=y
CONFIG_LINUX_KRNL_HEADER_IMG=y
CONFIG_SM6125=y
CONFIG_XIAOMI_GINKGO=y
CONFIG_TEXT_BASE=0x70000000
CONFIG_PAYLOAD_ENTRY=0x80000000
CONFIG_RAMDISK_ENTRY=0xa0000000
```

## configs/giulia_defconfig
```kconfig
CONFIG_POSITION_INDEPENDENT=y
CONFIG_LINUX_KRNL_HEADER_IMG=y
# CONFIG_COMPRESS_GZIP is not set
CONFIG_SM8650=y
CONFIG_ONEPLUS_GIULIA=y
CONFIG_TEXT_BASE=0xe1bb0000
CONFIG_PAYLOAD_ENTRY=0xb8000000
CONFIG_RAMDISK_ENTRY=0xb0000000
```

## configs/gta3xl_defconfig
```kconfig
CONFIG_POSITION_INDEPENDENT=y
# CONFIG_COMPRESS_GZIP is not set
CONFIG_EXYNOS_7885=y
CONFIG_SAMSUNG_GTA3XL=y
CONFIG_TEXT_BASE=0x88000000
CONFIG_PAYLOAD_ENTRY=0x90000000
CONFIG_RAMDISK_ENTRY=0x84000000
```

## configs/gta4xl_defconfig
```kconfig
CONFIG_POSITION_INDEPENDENT=y
# CONFIG_COMPRESS_GZIP is not set
CONFIG_EXYNOS_9610=y
CONFIG_SAMSUNG_GTA4XL=y
CONFIG_TEXT_BASE=0x88000000
CONFIG_PAYLOAD_ENTRY=0x90000000
CONFIG_RAMDISK_ENTRY=0x84000000
```

## configs/gts8wifi_defconfig
```kconfig
CONFIG_POSITION_INDEPENDENT=y
CONFIG_LINUX_KRNL_HEADER_IMG=y
CONFIG_SM8450=y
CONFIG_SAMSUNG_GTS8WIFI=y
CONFIG_TEXT_BASE=0x81400000
CONFIG_PAYLOAD_ENTRY=0x80b900000
CONFIG_RAMDISK_ENTRY=0xb6915000
CONFIG_SIMPLE_FB=y
```

## configs/j1qemu_defconfig
```kconfig
CONFIG_TEXT_BASE=0x60000000
CONFIG_EMBED_XNU=y
CONFIG_XNU_BLOB_LZ4=y
CONFIG_PAYLOAD_ENTRY=0x30001000
CONFIG_RAMDISK_ENTRY=0x22000000
CONFIG_RAMDISK_NO_COPY=y
CONFIG_COMPRESS_GZIP=n
CONFIG_LOGLEVEL=7
CONFIG_XNU_ENTRY_OFFSET=0xe58e0
# The shared cache is read from the SD card on this board, so do not
# spend ~154 MiB of boot.img on a copy nothing reads.
CONFIG_XNU_EMBED_CACHESLICE=n
CONFIG_XNU_PHYS_BASE=0x30000000
CONFIG_XNU_VIRT_BASE=0x80000000
CONFIG_XNU_MEMSIZE=0x25E00000
CONFIG_XNU_FB_BASE=0x57E05000
CONFIG_XNU_FB_WIDTH=480
CONFIG_XNU_FB_HEIGHT=800
CONFIG_XNU_CMDLINE="-v keepsyms=1 kprintf=1 debug=0x14e j1slot=0x2fe26624 j1uart=1 init=/sbin/launchd"
CONFIG_EXYNOS_3475=y
CONFIG_SAMSUNG_J1XLTE=y
CONFIG_EXYNOS_SDMMC3475=y
CONFIG_EXYNOS_SD_FAT=y
CONFIG_EXYNOS_SD_BOOT=y
CONFIG_EARLYCON=y
CONFIG_J1UART_MIRROR=y
```

## configs/kodiak_defconfig
```kconfig
CONFIG_QC32_8974=y
CONFIG_SIMPLE_FB=y
CONFIG_AMAZON_KODIAK=y
CONFIG_TEXT_BASE=0x8000
CONFIG_PAYLOAD_ENTRY=0x4000000
CONFIG_RAMDISK_ENTRY=0x2000000
CONFIG_FDT_BUF_ADDR=0x1e00000
```

## configs/lua_l21_defconfig
```kconfig
CONFIG_MT6735=y
CONFIG_HUAWEI_LUA_L21=y
CONFIG_SIMPLE_FB=y
CONFIG_LINUX_KRNL_HEADER_IMG=y
CONFIG_POSITION_INDEPENDENT=y
CONFIG_TEXT_BASE=0x4a000000
CONFIG_PAYLOAD_ENTRY=0x40200000
CONFIG_RAMDISK_ENTRY=0x44000000
```

## configs/m31_defconfig
```kconfig
CONFIG_POSITION_INDEPENDENT=y
# CONFIG_COMPRESS_GZIP is not set
CONFIG_EXYNOS_9610=y
CONFIG_SAMSUNG_M31=y
CONFIG_TEXT_BASE=0x88000000
CONFIG_PAYLOAD_ENTRY=0x90080000
CONFIG_RAMDISK_ENTRY=0x84000000
```

## configs/on7xelte_defconfig
```kconfig
CONFIG_POSITION_INDEPENDENT=y
CONFIG_EXYNOS_7870=y
CONFIG_SAMSUNG_ON7XELTE=y
CONFIG_TEXT_BASE=0x40080000
CONFIG_PAYLOAD_ENTRY=0x90000000
CONFIG_RAMDISK_ENTRY=0x84000000
```

## configs/p1ma40_defconfig
```kconfig
CONFIG_MT6735=y
CONFIG_SIMPLE_FB=y
CONFIG_LENOVO_P1MA40=y
CONFIG_LINUX_KRNL_HEADER_IMG=y
CONFIG_TEXT_BASE=0x40080000
CONFIG_PAYLOAD_ENTRY=0x80000000
CONFIG_RAMDISK_ENTRY=0xb0000000
```

## configs/pine_defconfig
```kconfig
CONFIG_UMS9620=y
CONFIG_SIMPLE_FB=y
CONFIG_ZTE_PINE=y
CONFIG_LINUX_KRNL_HEADER_IMG=y
CONFIG_TEXT_BASE=0x80080000
CONFIG_PAYLOAD_ENTRY=0x90000000
CONFIG_RAMDISK_ENTRY=0xa0000000
```
